// Definitions for JustBoom DAC
/dts-v1/;
/plugin/;

/ {
	model = "ROCK PI 4A";
    compatible = "rockchip,rockpi", "rockchip,rk3399";

    fragment@0 {
        target-path = [2f 00];

        __overlay__ {

            pcm5122@4d {
				#sound-dai-cells = <0>;
				compatible = "ti,pcm5122";
				reg = <0x4d>;
				status = "okay";
			};
        };

	fragment@1 {
        target-path = "/sound-ext-card";

		__overlay__ {
            compatible = "jusboom,justboom-dac";
            i2s-controller = <0xffffffff>;
            status = "okay";
        };
    };

    fragment@2 {
        target = <0xffffffff>;

        __overlay__ {
            status = "okay";
            #sound-dai-cells = <0x0>;
        };
    };

	__fixups__ {
        i2s1 = "/fragment@1/__overlay__:i2s-controller:0", "/fragment@2:target:0";
    };
};
